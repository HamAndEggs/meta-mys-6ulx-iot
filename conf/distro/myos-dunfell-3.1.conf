## conf/distro/myos-dunfell-3.1.conf
```bitbake
DISTRO_FEATURES_remove = "x11 wayland directfb "

DISTRO_FEATURES_append += " pam"

DISTRO_NAME = "MyOS Dunfell 3.1"
DISTRO_VERSION = "1.0.0"
DISTRO_CODENAME = "master"

PREFERRED_PROVIDER_virtual/kernel = "linux-fslc"
```

## conf/layer.conf
```bitbake
# We have a conf and classes directory, add to BBPATH
BBPATH .= ":${LAYERDIR}"

# We have recipes-* directories, add to BBFILES
BBFILES += "${LAYERDIR}/recipes-*/*/*.bb \
            ${LAYERDIR}/recipes-*/*/*.bbappend"

BBFILE_COLLECTIONS += "meta-mys-6ulx-iot"
BBFILE_PATTERN_meta-mys-6ulx-iot = "^${LAYERDIR}/"
BBFILE_PRIORITY_meta-mys-6ulx-iot = "8"
LAYERVERSION_meta-mys-6ulx-iot = "1"

LAYERSERIES_COMPAT_meta-mys-6ulx-iot="dunfell"
```

## conf/machine/mys-6ulx-iot.conf
```bitbake
#@TYPE: Machine
#@NAME:mys-6ulx-iot
#@SOC: i.MX6ULL
#@DESCRIPTION: Machine configuration for mys-6ulx-iot
#@MAINTAINER: Richard Collins

MACHINEOVERRIDES =. "mx6:mx6ull:"

include conf/machine/include/imx-base.inc
include conf/machine/include/tune-cortexa7.inc

KERNEL_DEVICETREE = "mys-6ulx-iot.dtb"


UBOOT_CONFIG ??= "sd"
UBOOT_CONFIG[sd] = "mx6ull_14x14_evk_config,sdcard"
UBOOT_CONFIG[mfgtool] = "mx6ull_14x14_evk_config"

SERIAL_CONSOLES = "115200;ttymxc0"

MACHINE_FEATURES += "wifi bluetooth"
```
